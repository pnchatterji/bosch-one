## sensor-api/bhy2/Kconfig.bhy2
```kconfig
#
# Copyright (c) 2023 Bosch Sensortec GmbH
#
# SPDX-License-Identifier: Apache-2.0
#

config BOSCH_BHY2
	bool "BHY2 Sensor API"
	default n
	help
	  Low-level device interface for BHIx60 devices
config BOSCH_BHY2_SWIM
	bool "BHY2 Sensor API for SWIM"
	depends on BOSCH_BHY2
	default n
config BOSCH_BHY2_PDR
	bool "BHY2 Sensor API for PDR"
	depends on BOSCH_BHY2
	default n
config BOSCH_BHY2_KLIO
	bool "BHY2 Sensor API for KLIO"
	depends on BOSCH_BHY2
	default n
config BOSCH_BHY2_BSEC
	bool "BHY2 Sensor API for BSEC"
	depends on BOSCH_BHY2
	default n
config BOSCH_BHI3
	bool "BHI3 Sensor API"
	depends on BOSCH_BHY2
	default n
```

## sensor-api/bmi270/Kconfig.bmi270
```kconfig
#
# Copyright (c) 2023 Bosch Sensortec GmbH
#
# SPDX-License-Identifier: Apache-2.0
#

config BOSCH_BMI270
	bool "BMI270 Sensor API"
	default n
	help
	  Low-level device interface for BMI270 device

#TODO: add configs for variants
```

## subsys/Kconfig
```kconfig
# Copyright (c) 2023 Bosch Sensortec GmbH
#
# SPDX-License-Identifier: Apache-2.0

rsource "fs/Kconfig"
```

## subsys/fs/Kconfig.flogfs
```kconfig
#
# Copyright (c) 2022 Bosch Sensortec GmbH
#
# SPDX-License-Identifier: Apache-2.0
#


config FILE_SYSTEM_FLOGFS
	bool "FLogFS support"
	depends on FILE_SYSTEM
	help
	  Enables FLogFS file system support.

if FILE_SYSTEM_FLOGFS
menu "FLogFS File System sample"

config FS_FLOGFS_NUM_FILES
	int "Maximum number of opened files"
	default 4
	help
	  This is a global maximum across all mounted flogfs filesystems.

config FS_FLOGFS_NUM_ITRS
	int "Maximum number of opened file iterators"
	default 1
	help
	  This is a global maximum across all mounted flogfs filesystems.

config FS_FLOGFS_COARSE_LOCKING
	bool "FLogFS Coarse Locking"
	default false
	help
	  Enables FLogFS file system locking at a coarse (filesystem) level.

config FS_FLOGFS_FINE_LOCKING
	bool "FLogFS Fine Locking"
	default true
	help
	  Enables FLogFS file system locking at a fine (file) level.
	  
endmenu

endif # FILE_SYSTEM_FLOGFS
```
