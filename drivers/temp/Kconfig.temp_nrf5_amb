## drivers/temp/Kconfig.temp_nrf5_amb
```kconfig
# Copyright (c) 2023 Bosch Sensortec GmbH
# SPDX-License-Identifier: Apache-2.0

config TEMP_NRF5_AMB
	bool "Modified NRF5 Temp Driver"
	default y
	depends on DT_HAS_NORDIC_NRF_TEMP_AMB_ENABLED
	help
	  Enable Modified NRF5 Temperature Driver.
```

## drivers/w1/Kconfig
```kconfig
# Copyright (c) 2023 Bosch Sensortec GmbH
# SPDX-License-Identifier: Apache-2.0

rsource "Kconfig.w1_bbash"
```

## drivers/w1/Kconfig.w1_bbash
```kconfig
# Copyright (c) 2023 Bosch Sensortec GmbH
# SPDX-License-Identifier: Apache-2.0

config W1_BBASH
	bool "W1 Bit-bashing driver"
	default y
	depends on DT_HAS_W1_BBASH_ENABLED
	select GPIO
	select DYNAMIC_INTERRUPTS
	select W1
	help
	  Enable W1 Bit-bashing driver
```

## dts/bindings/bat-level-adc.yaml
```yaml
# Copyright (c) 2020 Bosch Sensortec GmbH
# SPDX-License-Identifier: Apache-2.0

description: Battery Level sensor using ADC and voltage divider 

compatible: "bat-level-adc"

# inherits from voltage divider bindings
include: voltage-divider.yaml

properties:
    bat-max-mv:
      type: int
      required: true
      description: max voltage (charging voltage) of battery in mv
    bat-min-mv:
      type: int
      required: true
      description: min voltage (cutoff voltage) of battery in mv
    work-interval-ms:
      type: int
      required: true
      description: how often the battery level is sampled in ms
    lut-delta:
      type: int
      required: true
      description: |
        delta mv corresponding to two successive entries in below mv-soc look-up-table. It should
        be computed like this:
        (uint32_t)(((bat_max_mv - bat_min_mv) / (sizeof(bat_mv_soc_lut)))+0.5);
    bat-mv-soc-lut:
      type: array
      required: true
      description: |
        mv-soc look-up-table for battery. First is the soc corresponding to bat min voltage 
        defined above and the final entry is the soc corresponding to bat max voltage. The delta 
        mv between successive entries is defined above

    
```

## dts/bindings/bosch,bhix60.yaml
```yaml
# Copyright (c) 2020 Bosch Sensortec GmbH
# SPDX-License-Identifier: Apache-2.0

description: Bosch BHIx60 smart sensor 

# Currently only SPI is supported
compatible: "bosch,bhix60"

include: spi-device.yaml

properties:
    reset-gpios:
      type: phandle-array
      required: true
      description: Reset pin of BHIx60
    hirq-gpios:
      type: phandle-array
      required: true
      description: Interrupt Out pin of BHIx60
```

## dts/bindings/bosch,bmxx-spi.yaml
```yaml
# Copyright (c) 2020 Bosch Sensortec GmbH
# SPDX-License-Identifier: Apache-2.0

description: Bosch BHI260 smart sensor 

# bmxx_spi represents the primary SPI interface of a BST sensor
# chip mounted on an Application Board Shuttle Board

compatible: "bosch,bmxx-spi"

include: spi-device.yaml
```

## dts/bindings/bosch,shuttle-board.yaml
```yaml
# Copyright (c) 2022, Bosch Sensortec GmbH
# SPDX-License-Identifier: Apache-2.0

description: Sensor Shuttle Board GPIO control pins

compatible: "bosch,shuttle-board"

child-binding:
    description: GPIO Pin for Sensor Shuttle Board control
    properties:
       gpios:
          type: phandle-array
          required: true
       label:
          required: true
          type: string
          description: description of shuttle board control pin
```

## dts/bindings/dummy-eeprom.yaml
```yaml
# Copyright (c) 2023 2023 Bosch Sensortec GmbH
# SPDX-License-Identifier: Apache-2.0

description: |
    Dummy EEPROM driver that uses a RAM array to simulate EEPROM

compatible: "dummy-eeprom"

include: eeprom-base.yaml
properties:
    eeprom-data:
      type: array
      required: true
      description: |
        Array representing pre-programmed EEPROM contents, if any, else 0.
```

## dts/bindings/issi,is31fl3194.yaml
```yaml
description: Lumissil (ISSI) IS31FL3194 LED

compatible: "issi,is31fl3194"

include: i2c-device.yaml
```

## dts/bindings/maxim,ds28e05.yaml
```yaml
# Copyright (c) 2023 2023 Bosch Sensortec GmbH
# SPDX-License-Identifier: Apache-2.0

description: |
    EEPROM driver binding for DS28E05

compatible: "maxim,ds28e05"

include: [eeprom-base.yaml, w1-slave.yaml]
```

## dts/bindings/nordic,nrf-temp-amb.yaml
```yaml
# Copyright (c) 2023, Bosch Sensortec GmbH
# SPDX-License-Identifier: Apache-2.0

description: Nordic nRF family TEMP node modified for ambient temp

compatible: "nordic,nrf-temp-amb"

include: nordic,nrf-temp.yaml
```

## dts/bindings/ti,bq25120.yaml
```yaml
description: TI BQ25120 Battery Manager

compatible: "ti,bq25120"

include: i2c-device.yaml
properties:
    cd-gpios:
        type: phandle-array
        required: true
        description: Host pin connected to BQ25120 Chip Disable (CD) pin

    lsctrl-gpios:
        type: phandle-array
        required: false
        description: Host pin connected to BQ25120 LSCTRL pin, if any

    int-gpios:
        type: phandle-array
        required: false
        description: Host pin connected to BQ25120 INT pin, if any

    reset-gpios:
        type: phandle-array
        required: false
        description: Host pin connected to BQ25120 RESET pin, if any

    sys_vout_mv:
        type: int
        required: true
        description: Output voltage of SYS in mv - min 1100, max 3300, 0 to disable (0,1.1-3.3V)

    ls_ldo_mv:
        type: int
        required: true
        description: Output voltage of LS/LDO in mv - min 800, max 3300, 0 to disable (0,0.8-3.3V)

    bat_reg_mv:
        type: int
        required: true
        description: regulation voltage of battery in mv (3.6-4.65V)

    ilim_ma:
        type: int
        required: true
        description: Input current limit of device in mA. (50-400 mA)

    bat_uvlo_mv:
        type: int
        required: true
        description: Battery under-voltage lockout in mV (2.2-3 V, Disable UVLO:0)
    
    icharge_ma:
        type: int
        required: true
        description: Charging current in mA (5-300mA, Disable Charger:0)

    ipreterm_ua:
        type: int
        required: true
        description: |
            pre-charging current/terminating current in uA (500uA to 37000uA (37mA), Disable Termination:0)
            This is charging current at start and end of charging, usually 10% of peak

    mrreset_vin:
        type: int
        required: false
        default: 0
        description: Reset when Reset time expires 0-Always 1-When Vin is healthy

    wake1_ms:
        type: int
        required: false
        default: 0
        description: Wake1 time setting in ms - 50 or 500 ms, 0 to disable 

    wake2_ms:
        type: int
        required: false
        default: 0
        description: Wake2 time setting in ms - 1000 or 1500 ms, 0 to disable 

    reset_s:
        type: int
        required: false
        default: 0
        description: Reset time setting in Sec - 4, 8, 10 or 14, 0 to disable 
    
    mrrec:
        type: int
        required: false
        default: 0
        description: After Reset, device enters 0 - Ship mode, 1 - Hi-Z Mode

    timer_int_en:
        type: int
        required: false
        default: 0
        description: Enable interrupt signalling of timer events

    ts_int_en:
        type: int
        required: false
        default: 0
        description: Enable interrupt signalling of temperature sensor (TS) events

    charge_int_en:
        type: int
        required: false
        default: 0
        description: Enable interrupt signalling of charging events

    pg_mr:
        type: int
        required: false
        default: 0
        description: Use PG Output as 0-Power Good Status, 1-MR Input Status
```

## dts/bindings/w1-bbash.yaml
```yaml
# Copyright (c) 2023 2023 Bosch Sensortec GmbH
# SPDX-License-Identifier: Apache-2.0

description: |
    W1 Bit-bashing driver

compatible: "w1-bbash"

include: w1-master.yaml

properties:
    w1-gpios:
        type: phandle-array
        required: true
        description: Host GPIO pin connected to 1-wire device pin

    nrf_timer_num:
        type: int
        required: true
        description: NRFX TIMER Number (0-6 on nrf52) to be used for 1-wire bit bashing on w1-gpios
```

## dts/bindings/winbond,spim-nand.yaml
```yaml
# Copyright (c) 2020 Bosch Sensortec GmbH
# SPDX-License-Identifier: Apache-2.0

description: Winbond NAND Flash (valid for W25M02GW,W25N01GW and W25N02JW) 

# Winbond W25 is an SPIM device
compatible: "winbond,spim-nand"

include: spi-device.yaml

properties:
    hold-gpios:
      type: phandle-array
      required: false
      description: Hold pin of SPI (optional as it may be hard wired)
    wp-gpios:
      type: phandle-array
      required: false
      description: Hold pin of SPI (optional as it may be hard wired)

    
```

## dts/bindings/zephyr,fstab,flogfs.yaml
```yaml
#Copyright (c) 2022 Bosch Sensortec GmbH
# SPDX-License-Identifier: Apache-2.0

description: |
    FlogFS file system wrapper for Zephyr

compatible: "zephyr,fstab,flogfs"

include: "zephyr,fstab-common.yaml"

properties:
    sector_size:
        type: int
        required: true
        description: size of sector in bytes
    sectors_per_page:
        type: int
        required: true
        description: number of sectors per page
    pages_per_block:
        type: int
        required: true
        description: pages per block
    num_blocks:
        type: int
        required: true
        description: number of blocks available (total blocks - reserve)        
    pre_allocate_size:
      type: int
      required: true
      description: pre-allocation size
    inode0_max_block:
      type: int
      required: true
      description: max blocks in inode0
```

## lib/COINES/Kconfig.coines
```kconfig
#
# Copyright (c) 2022 Bosch Sensortec GmbH
#
# SPDX-License-Identifier: Apache-2.0
#

menu "COINES"
config COINES
	bool "Enable COINES"
	select REBOOT
	select PIPES
	select RING_BUFFER
	depends on SYSTEM_WORKQUEUE_STACK_SIZE >= 2048
#	depends on MAIN_STACK_SIZE >= 16384
	help
	  Enable COINES on Zephyr library

config COINES_TIMED_INTR_TIMER
	int "Timer used by COINES Timed Interrupt API"
	default 3
	help
	  Timer used by COINES Timed Interrupt API. It is set by default 
	  to 3 as TIMER3 in nrf52 has 6 capture channels, and COINES needs
	  the extra capture channels.

config COINES_TIMED_INTR_ENABLE
	bool "Enable Timed Interrupt feature in COINES API"
	default true
	select NRFX_TIMER3
	select NRFX_PPI
	select NRFX_GPIOTE
	help
	  Enable Timed Interrupt feature in COINES API. This feature uses
	  PPI and GPIOTE, which are automatically enabled. It also uses
	  nrf52 TIMER3 by default. To use a different timer, set 
	  CONFIG_COINES_TIMED_INTR_TIMER to the reqd value, and enable the
	  corresponding timer in prj.conf

config COINES_INTF_BLE_ENABLE
	bool "Enable BLE Interface in COINES"
	default true
	help
	  Enable BLE related features in COINES API such as
	  NUS, HTS and BAT

config COINES_INTF_USB_ENABLE
	bool "Enable USB Interface in COINES"
	default true
	help
	  Enable USB interface in COINES to enable communication
	  with host via USB console terminal

config BT_NUS_THREAD_STACK_SIZE
	int "Thread stack size"
	default 1024
	help
	  Stack size used in each of the two threads

config BT_NUS_UART_BUFFER_SIZE
	int "UART payload buffer element size"
	default 40
	help
	  Size of the payload buffer in each RX and TX FIFO element

config BT_NUS_SECURITY_ENABLED
	bool "Enable security"
	default n
	select BT_SMP
	help
	  "Enable BLE security for the UART service"

config BT_NUS_UART_DEV
	string "UART device name"
	default "UART_0"
	help
	  Name of the used UART device. The sample uses uart0 by default.
	  The UART device should not be used as logger backend.

config BT_NUS_UART_RX_WAIT_TIME
	int "Timeout for UART RX complete event"
	default 50
	help
	  Wait for RX complete event time in milliseconds


config BT_NUS_UART_ECHO
	bool "Enable NUS UART Echo"
	default y
	help
	  Enable Echo of data received from UART terminal. Useful for testing.

config NUS_READ_BUF_SIZE
	int "NUS read buffer size"
	default 100
	help
	  Size of ring buffer to allocate for NUS read. If too small, can lead 
	  to data loss if not emptied fast enough by application reads operations
config HTS_PROC_RATE_MS
	int "HTS processing rate (MS)"
	default 1000
	help
	  Rate at which HTS service is processed (in milliseconds). In Bosch AB3.0
	  this controls how often notifications for board temperature and Battery 
	  Level are sent via BLE services

config ADC_WORK_INTERVAL_MS
	int "ADC sampling rate (ms)"
	default 2000
	help
	  MS interval between ADC samplings. In Bosch Application Board 3.0
	  this primarily controls how often the battery level is sampled

config TEMP_DEV_CHANNEL_DIE
	bool "Temperature device measures die temp"
	default n
	help
	  Board temperature sensor usually measures ambient temperature (eg for AB3) but it can
	  be die temperature as in case of Nicla
endmenu
```

## samples/coines/bmi270/accel/sample.yaml
```yaml
sample:
  name: COINES BMI270 Accel Sample
tests:
  sample.coines.bmi270.accel:
    harness: sensor
    tags: samples coines bmi270
```

## samples/coines/coines_bridge_firmware/sample.yaml
```yaml
sample:
  name: COINES Bridge Firmware
tests:
  sample.coines.coinesbridgefw:
    harness: sensor
    tags: samples coines
```

## samples/coines/sensor_app/sample.yaml
```yaml
sample:
  name: Generic Sensor Example App using COINES
tests:
  sample.coines.sensorapp:
    harness: sensor
    tags: samples coines
```

## samples/coines/sensor_script/sample.yaml
```yaml
sample:
  name: Scripts to run all Examples of a Sensor using COINES
tests:
  sample.coines.sensorscript:
    harness: sensor
    tags: samples coines script
```

## samples/sensor/sensor_driver_template/Kconfig
```kconfig
#
# Copyright (c) 2022 Bosch Sensortec GmbH
#
# SPDX-License-Identifier: Apache-2.0
#

source "Kconfig.zephyr"

#TIP: This Kconfig file is used to properly build the test app that combines
#the sample code and the driver, prior to deployment.
#It will not actually be deployed to Zephyr
rsource "driver/Kconfig"
```

## samples/sensor/sensor_driver_template/driver/Kconfig
```kconfig
#
# Copyright (c) 2023 Bosch Sensortec GmbH
#
# SPDX-License-Identifier: Apache-2.0
#

config BXX
	bool "BXX driver"
	default y
	depends on DT_HAS_BOSCH_BXX_ENABLED
	select SPI
	select I2C
	help
	  Enable BXX sensor driver.
config BXX_TRIGGER
	bool "BXX Trigger"
	default y
	depends on DT_HAS_BOSCH_BXX_ENABLED
	help
	  Enable sensor event trigger driven by the BXX interrupt
	  pin(s). The interrupt pins GPIOS need to be defined in the DTS 
	  overlay for this to function.
#TIP: Add any additional build configuration parameters
#needed by the BXX driver. This can be enabled/disabled in prj.conf
#and used in the driver code for conditional compilation and
#configurable constants
```
