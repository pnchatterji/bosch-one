## Kconfig
```kconfig
rsource "drivers/Kconfig"
rsource "lib/Kconfig"
rsource "subsys/Kconfig"
rsource "sensor-api/Kconfig"
```

## boards/arm/bosch_app30/Kconfig.board
```kconfig
# BOSCH-APP30 board configuration

# Copyright (c)2023 Bosch Sensortec GmbH
# SPDX-License-Identifier: Apache-2.0

config BOARD_BOSCH_APP30
	bool "BOSCH-APP30"
	depends on SOC_NRF52840_QIAA

config BOSCH_SHUTTLE_VDD_MV
	int "VDD for Shuttle board in MV: 1800 or 2800"
	depends on BOARD_BOSCH_APP30

config BOSCH_USB_AUTO_START
	bool "Auto start USB Driver for console support via USB"
	depends on BOARD_BOSCH_APP30

#Information returned by coines_get_board_info()
config COINES_BOARD_ID
	int "COINES Board ID"
config COINES_HW_ID
	int "COINES HW ID"
config COINES_SW_ID
	int "COINES SW ID"
```

## boards/arm/bosch_app30/Kconfig.defconfig
```kconfig
# Copyright (c) 2021 Nordic Semiconductor ASA
# SPDX-License-Identifier: Apache-2.0
# INFO:
# Kconfig.defconfig => invisible symbols
# <board>_defconfig => visible symbols

if BOARD_BOSCH_APP30

config BOARD
	default "bosch_app30"

config BT_CTLR
   default BT

config FLASH_LOAD_OFFSET
	default 0x30000

config BOSCH_SHUTTLE_VDD_MV
	default 1800

if USB_DEVICE_STACK
config UART_LINE_CTRL
	default y
config BOSCH_USB_AUTO_START
	default y
endif # USB_DEVICE_STACK

config IEEE802154_NRF5
	default y
	depends on IEEE802154

endif
```

## boards/arm/bosch_app31/Kconfig.board
```kconfig
# BOSCH-APP31 board configuration

# Copyright (c)2023 Bosch Sensortec GmbH
# SPDX-License-Identifier: Apache-2.0

config BOARD_BOSCH_APP31
	bool "BOSCH-APP31"
	depends on SOC_NRF52840_QIAA

config BOSCH_SHUTTLE_VDD_MV
	int "VDD for Shuttle board in MV: 1800 or 2800"
	depends on BOARD_BOSCH_APP31

#this is set equal to BOSCH_SHUTTLE_VDD_MV in defconfig
#to avoid BOSCH specific config variables in PMIC driver
config  BQ25120_LDO_MV
	int "LDO voltage setting for PMIC in mv"
	depends on BOARD_BOSCH_APP31

config BOSCH_USB_AUTO_START
	bool "Auto start USB Driver for console support via USB"
	depends on BOARD_BOSCH_APP31

#Information returned by coines_get_board_info()
config COINES_BOARD_ID
	int "COINES Board ID"
config COINES_HW_ID
	int "COINES HW ID"
config COINES_SW_ID
	int "COINES SW ID"
```

## boards/arm/bosch_app31/Kconfig.defconfig
```kconfig
# Copyright (c) 2021 Nordic Semiconductor ASA
# SPDX-License-Identifier: Apache-2.0
# INFO:
# Kconfig.defconfig => invisible symbols
# <board>_defconfig => visible symbols

if BOARD_BOSCH_APP31

config BOARD
	default "bosch_app31"

config BT_CTLR
   default BT

config FLASH_LOAD_OFFSET
	default 0x30000

config BOSCH_SHUTTLE_VDD_MV
	default 1800

#this is set equal to BOSCH_SHUTTLE_VDD_MV in defconfig
#to avoid BOSCH specific config variables in PMIC driver
#note that BOSCH_SHUTTLE_VDD_MV can be overridden in prj.conf
config BQ25120_LDO_MV
	default BOSCH_SHUTTLE_VDD_MV

if USB_DEVICE_STACK
config UART_LINE_CTRL
	default y
config BOSCH_USB_AUTO_START
	default y
endif # USB_DEVICE_STACK

config IEEE802154_NRF5
	default y
	depends on IEEE802154

endif
```

## boards/arm/bosch_nicla_sense/Kconfig.board
```kconfig
# Configuration for Arduino Nicla Sense ME board pre-configured 
# for Bosch Sensortec Drivers and COINES library

# Copyright (c) 2023 Bosch Sensortec GmbH
# SPDX-License-Identifier: Apache-2.0

config BOARD_BOSCH_NICLA_SENSE
	bool "Bosch Nicla Sense"
	depends on SOC_NRF52832_QFAA

#Added for compatibility with Bosch Application Boards
#ignored in Nicla
config BOSCH_SHUTTLE_VDD_MV
	int "VDD for Shuttle board in MV: always 1800 for Nicla"
	depends on BOARD_BOSCH_NICLA_SENSE

#Added for compatibility with Bosch Application Boards
#ignored in Nicla
config BOSCH_USB_AUTO_START
	bool "Auto start USB Driver"

#Information returned by coines_get_board_info()
config COINES_BOARD_ID
	int "COINES Board ID"
config COINES_HW_ID
	int "COINES HW ID"
config COINES_SW_ID
	int "COINES SW ID"
```

## boards/arm/bosch_nicla_sense/Kconfig.defconfig
```kconfig
# Configuration for Arduino Nicla Sense ME board pre-configured 
# for Bosch Sensortec Drivers and COINES library

# Copyright (c) 2023 Bosch Sensortec GmbH
# SPDX-License-Identifier: Apache-2.0

if BOARD_BOSCH_NICLA_SENSE

config BOARD
	default "bosch_nicla_sense"

config BT_CTLR
	default BT

endif # BOARD_BOSCH_NICLA_SENSE
```

## boards/arm/bst_ab3_nrf52840/Kconfig.board
```kconfig
# BST-AB3 board configuration

# Copyright (c)2022 Bosch Sensortec GmbH
# SPDX-License-Identifier: Apache-2.0

config BOARD_BST_AB3_NRF52840
	bool "BST-AB3-NRF52840"
	depends on SOC_NRF52840_QIAA

config BST_SHUTTLE_SELECT_VDD_2_8
	bool "BST SHUTTLE SELECT VDD 2.8V"
	depends on BOARD_BST_AB3_NRF52840

config BST_USB_AUTO_START
	bool "Auto start USB Driver for console support via USB"
	depends on BOARD_BST_AB3_NRF52840
```

## boards/arm/bst_ab3_nrf52840/Kconfig.defconfig
```kconfig
# Copyright (c) 2021 Nordic Semiconductor ASA
# SPDX-License-Identifier: Apache-2.0

if BOARD_BST_AB3_NRF52840

config BOARD
	default "bst_ab3_nrf52840"

config BT_CTLR
   default BT

config FLASH_LOAD_OFFSET
	default 0x30000

config BST_AB3_NRF52840_SELECT_VDD_2_8
	default y

if USB_DEVICE_STACK
config UART_LINE_CTRL
	default y
config BST_AB3_USB_AUTO_START
	default y
endif # USB_DEVICE_STACK

config IEEE802154_NRF5
	default y
	depends on IEEE802154

endif
```

## boards/arm/bst_ab3_nrf52840/bst_ab3_nrf52840_defconfig
```kconfig
# BST-AB3-NRF52840 board configuration
#  Copyright (c) 2022 Bosch Sensortec GmbH
# SPDX-License-Identifier: Apache-2.0
# INFO:
# Kconfig.defconfig => invisible symbols
# <board>_defconfig => visible symbols

CONFIG_SOC_SERIES_NRF52X=y
CONFIG_SOC_NRF52840_QIAA=y
CONFIG_BOARD_BST_AB3_NRF52840=y

#Information returned by coines_get_board_info() for AB3.0
CONFIG_COINES_BOARD_ID=5
CONFIG_COINES_HW_ID=17
CONFIG_COINES_SW_ID=16

# Enable MPU
CONFIG_ARM_MPU=y
 
# Enable hardware stack protection
CONFIG_HW_STACK_PROTECTION=y
 
# enable GPIO
CONFIG_GPIO=y

#Enable Console 
CONFIG_SERIAL=y
CONFIG_CONSOLE=y
CONFIG_UART_LINE_CTRL=n

#Enable USB for console
CONFIG_USB_DEVICE_STACK=y
CONFIG_USB_CDC_ACM=y
CONFIG_UART_ASYNC_API=y

# Enable Segger RTT for logging (only)
CONFIG_USE_SEGGER_RTT=y
 
#Use RTT for logging, and USB UART for Console
CONFIG_LOG_BACKEND_RTT=y
CONFIG_LOG_BACKEND_UART=n
CONFIG_RTT_CONSOLE=n
CONFIG_UART_CONSOLE=y

CONFIG_USB_DEVICE_PRODUCT="Bosch Application Board 3.0"
CONFIG_USB_DEVICE_VID=0x108C
CONFIG_USB_DEVICE_PID=0xAB3C
#enable auto launch of USB driver, so that console is available by default
CONFIG_BST_USB_AUTO_START=y
 
#Disable the UARTE0 in default project configuration
#URTE1 was enabled for EEPROM reading via serial-w1 1-wire driver
#not reqd now
CONFIG_NRFX_UARTE0=n
#CONFIG_NRFX_UARTE1=y
#CONFIG_UART_NRFX=y
CONFIG_NRFX_UARTE1=n
CONFIG_UART_NRFX=n
 
# additional board options
# Disable reset pin, to use TB1 & TB2 as normal buttons
CONFIG_GPIO_AS_PINRESET=n
CONFIG_UART_INTERRUPT_DRIVEN=y
#enable the pinctrl drivers for spi,i2c etc 
CONFIG_PINCTRL=y

#The 1-Wire driver for Shuttle PROM uses NRFX Timer 1 by default
#on AB3. To change the timer, modify the w1 node in board DTS or in 
#a DTS overlay, and enable the new timer
#dynamic interrupts are also required by the 1-wire driver
CONFIG_NRFX_TIMER1=y
CONFIG_DYNAMIC_INTERRUPTS=y
```

## boards/arm/bst_arduino_nicla/Kconfig.board
```kconfig
# Configuration for Arduino Nicla Sense ME board pre-configured 
# for Bosch Sensortec Drivers and COINES library

# Copyright (c) 2023 Bosch Sensortec GmbH
# SPDX-License-Identifier: Apache-2.0

config BOARD_BST_ARDUINO_NICLA
	bool "BST Arduino Nicla"
	depends on SOC_NRF52832_QFAA

#Added for compatibility with BST Application Boards
#ignored in Nicla
config BST_SHUTTLE_SELECT_VDD_2_8
	bool "BST SHUTTLE SELECT VDD 2.8V"
	depends on BOARD_BST_ARDUINO_NICLA

#Added for compatibility with BST Application Boards
#ignored in Nicla
config BST_USB_AUTO_START
	bool "Auto start USB Driver"

#Information returned by coines_get_board_info()
config COINES_BOARD_ID
	int "COINES Board ID"
config COINES_HW_ID
	int "COINES HW ID"
config COINES_SW_ID
	int "COINES SW ID"
```

## boards/arm/bst_arduino_nicla/Kconfig.defconfig
```kconfig
# Configuration for Arduino Nicla Sense ME board pre-configured 
# for Bosch Sensortec Drivers and COINES library

# Copyright (c) 2023 Bosch Sensortec GmbH
# SPDX-License-Identifier: Apache-2.0

if BOARD_BST_ARDUINO_NICLA

config BOARD
	default "bst_arduino_nicla"

config BT_CTLR
	default BT

endif # BOARD_BST_ARDUINO_NICLA
```

## boards/arm/bst_arduino_nicla/bst_arduino_nicla_defconfig
```kconfig
# SPDX-License-Identifier: Apache-2.0

CONFIG_SOC_SERIES_NRF52X=y
CONFIG_SOC_NRF52832_QFAA=y
CONFIG_BOARD_BST_ARDUINO_NICLA=y

# Enable MPU
CONFIG_ARM_MPU=y
CONFIG_HW_STACK_PROTECTION=y

# enable GPIO
CONFIG_GPIO=y

# enable uart driver
CONFIG_SERIAL=y

#Nicla accesses USB via a bridge. Switch off USB related
#modules just to be sure
CONFIG_USB_DEVICE_STACK=n
CONFIG_USB_CDC_ACM=n
CONFIG_UART_ASYNC_API=n
CONFIG_BST_USB_AUTO_START=n

CONFIG_SPI_NOR_FLASH_LAYOUT_PAGE_SIZE=4096

# enable console
CONFIG_CONSOLE=y
CONFIG_UART_CONSOLE=y
#Use UART for logging
CONFIG_LOG_BACKEND_UART=y
# additional board options
# Disable reset pin, to use PB1 as normal button
CONFIG_GPIO_AS_PINRESET=n

# enable pin controller
CONFIG_PINCTRL=y
```

## drivers/Kconfig
```kconfig
rsource "bat/Kconfig"
rsource "flash/Kconfig"
rsource "led/Kconfig"
rsource "sensor/Kconfig"
rsource "temp/Kconfig"
rsource "eeprom/Kconfig"
rsource "w1/Kconfig"
```

## drivers/bat/Kconfig
```kconfig
# Copyright (c) 2023 Bosch Sensortec GmbH
# SPDX-License-Identifier: Apache-2.0

config BATTERY_SENSE
	bool "Battery Sensing Driver"
	default n
	help
	  Enable a battery level sensing driver.
rsource "Kconfig.bq25120"
rsource "Kconfig.bat_level_adc"
```

## drivers/bat/Kconfig.bat_level_adc
```kconfig
# Copyright (c) 2023 Bosch Sensortec GmbH
# SPDX-License-Identifier: Apache-2.0

config BAT_LEVEL_ADC
	bool "Voltage Divider and ADC Based Battery Level Detector"
	default y
	depends on DT_HAS_BAT_LEVEL_ADC_ENABLED
	select ADC
	select ADC_ASYNC
	select ADC_NRFX_SAADC
	select BATTERY_SENSE
	help
	  Enable driver for  Battery Level Detector via ADC and voltage divider.
```

## drivers/bat/Kconfig.bq25120
```kconfig
# Copyright (c) 2023 Bosch Sensortec GmbH
# SPDX-License-Identifier: Apache-2.0

config BQ25120
	bool "BQ25120 Battery Controller driver"
	default y
	depends on DT_HAS_TI_BQ25120_ENABLED
	select I2C
	select BATTERY_SENSE
	help
	  Enable BQ25120 Battery Controller driver.
```

## drivers/eeprom/Kconfig
```kconfig
# Copyright (c) 2023 Bosch Sensortec GmbH
# SPDX-License-Identifier: Apache-2.0

rsource "Kconfig.ds28e05"
rsource "Kconfig.dummy_eeprom"
```

## drivers/eeprom/Kconfig.ds28e05
```kconfig
# Copyright (c) 2023 Bosch Sensortec GmbH
# SPDX-License-Identifier: Apache-2.0

config DS28E05
	bool "DS28E05 driver"
	default y
	depends on DT_HAS_MAXIM_DS28E05_ENABLED
	select GPIO
	help
	  Enable EEPROM driver for DS28E05
```

## drivers/eeprom/Kconfig.dummy_eeprom
```kconfig
# Copyright (c) 2023 Bosch Sensortec GmbH
# SPDX-License-Identifier: Apache-2.0

config DUMMY_EEPROM
	bool "Dummy EEPROM driver"
	default y
	depends on DT_HAS_DUMMY_EEPROM_ENABLED
	help
	  Enable Dummy EEPROM driver for EEPROM Simulation
```

## drivers/flash/Kconfig
```kconfig
#
# Copyright (c) 2022 Bosch Sensortec GmbH
#
# SPDX-License-Identifier: Apache-2.0
#

rsource "w25_spim_nand/Kconfig"
```

## drivers/flash/w25_spim_nand/Kconfig
```kconfig
#
# Copyright (c) 2022 Bosch Sensortec GmbH
#
# SPDX-License-Identifier: Apache-2.0
#

config W25_SPIM_NAND
	bool "W25XX SPIM NAND Driver"
	depends on DT_HAS_WINBOND_SPIM_NAND_ENABLED
	default y
	help
		W25XX driver should be enabled on AB3 to use the external flash 
		chip W25M02GW or other chips in this family
```

## drivers/led/Kconfig.fl3194
```kconfig
# Copyright (c) 2023 Bosch Sensortec GmbH
# SPDX-License-Identifier: Apache-2.0

config FL3194
	bool "FL3194 LED driver"
	default y
	depends on DT_HAS_ISSI_IS31FL3194_ENABLED
	select I2C
	select LED
	help
	  Enable LED driver for FL3194.
```

## drivers/sensor/bhix60/Kconfig.bhix60
```kconfig
#
# Copyright (c) 2023 Bosch Sensortec GmbH
#
# SPDX-License-Identifier: Apache-2.0
#

config BHIX60
	bool "BHIx60 driver"
	default y
	depends on DT_HAS_BOSCH_BHIX60_ENABLED
	depends on HEAP_MEM_POOL_SIZE >= 2048
	depends on MAIN_STACK_SIZE >= 8192
	select SPI
	select BOSCH_BHY2
	help
	  Enable BHIx60 smart sensor driver. The BHIx60 driver requires a heap and
	  a larger than usual stack size to support the BHY2 Sensor API

config BHIX60_STATUS_DEBUG
	bool "BHIx60 status and debug FIFO"
	default n
	help
	  Enables BHI260 FIFO for status and debug events

choice BHIX60_BOOT_ACTION
	bool "BHIx60 Boot Action"
	default BHIX60_UPLOAD_FW_TO_RAM 
config BHIX60_FLASH_AUTO_BOOT
	bool "Auto boot BHIx60 from Flash"
	help
	  boot BHI260 from its flash at startup, if firmware has been pre-flashed
config BHIX60_UPLOAD_FW_TO_RAM
	bool "Upload FW to RAM and boot"
	help
	  upload app-defined FW to BHIx60 RAM, and boot from it 
config BHIX60_UPLOAD_FW_TO_FLASH
	bool "Upload FW to FLASH and boot"
	help
	  upload app-defined FW to BHIx60 FLASH, and boot from it 
endchoice

choice BHIX60_FIFO_MODE
	prompt "FIFO processing mode"
	help
	  Specify how the BHIx60 FIFO will be processed.
	default BHIX60_FIFO_POLL 
config BHIX60_FIFO_POLL
	bool "Poll the INT pin"
	help
	  The BHIx60 INT pin will be polled in a fetch loop.
config BHIX60_FIFO_INT_GLOBAL_THREAD
	bool "hw interrupt, global thread"
	help
	  Set BHIx60 INT pin as hw interrupt, handle in the global thread.
config BHIX60_FIFO_INT_FIFO_THREAD
	bool "hw interrupt, FIFO thread"
	help
	  Set BHIx60 INT pin as hw interrupt, handle in a special FIFO thread..
endchoice

config BHIX60_VIRTUAL_SENSORS_USED
	int "Number of Virtual Sensors used by the application"
	default 10
	help
	  The number of BHIx60 virtual sensors actually used by the application. This should be 
	  set as precisely as possible. Setting it too large wastes RAM, as a mailbox slot is maintained
	  for each virtual sensor used. Setting it too low can lead to runtime errors as all the required 
	  virtual sensors cannot be initialized
config BHIX60_MAX_SLOT_TRIGGERS 
	int "Max triggers per virtual sensors"
	default 2
	help 
		Maximum number of triggers supported per virtual sensor
config BHIX60_FIFO_THREAD_STACK_SIZE
	int "Stack size of FIFO thread"
	default 1024
	help 
		Stack size of FIFO thread if CONFIG_BHIX60_FIFO_INT_FIFO_THREAD is active
config BHIX60_FIFO_THREAD_PRIORITY
	int "FIFO thread priority"
	default 10
	help 
		Priority of FIFO thread if CONFIG_BHIX60_FIFO_INT_FIFO_THREAD is active
```
